## guest/linux/Kconfig
```kconfig
config CONDUIT_GPU
    bool "Conduit guest GPU driver"
    depends on VIRTIO
    default y
    help
        Conduit's guest driver. Provides the /dev/nvidia* device files and a
        DRM/KMS device inside the VM and forwards their ioctls to the host's
        NVIDIA driver over virtio, so NVIDIA's own user-space driver runs
        unchanged. GPU memory is mapped from the device's shared-memory
        regions; command submission does not go through the VMM.

        Required for CUDA, Vulkan, OpenGL, NVENC and NVDEC inside a Conduit
        VM. The module is called conduit_gpu. If unsure, say N.
```
